## code/blue_pot_esp32/Kconfig
```kconfig
# Kconfig for Blue POT ESP32 Project

menu "Blue POT Configuration"

    config BT_UART_NUM
        int "Bluetooth UART Number"
        default 2
        range 0 2
        help
            UART number for BM64 Bluetooth module communication

    config BT_UART_BAUD
        int "Bluetooth UART Baud Rate"
        default 115200
        range 9600 1000000
        help
            Baud rate for BM64 communication (typically 115200)

    config POTS_SAMPLE_RATE
        int "POTS Audio Sample Rate (Hz)"
        default 8000
        range 8000 44100
        help
            Audio sampling rate for DTMF detection and tone generation

    config ENABLE_VERBOSE_LOGGING
        bool "Enable Verbose Logging by Default"
        default n
        help
            Enable detailed debug logging of Bluetooth packets on startup

    config DTMF_DETECTION_METHOD
        int "DTMF Detection Method"
        default 0
        range 0 2
        help
            0 = Threshold-based (simple, current implementation)
            1 = Goertzel algorithm (recommended)
            2 = FFT-based (better, requires more CPU)

endmenu
```

## code/blue_pot_esp32/sdkconfig.defaults
```kconfig
# ESP-IDF Configuration for Blue POT ESP32

# Chip options
CONFIG_IDF_TARGET="esp32"
CONFIG_IDF_FIRMWARE_CHIP_ID=0x0000

# FreeRTOS options
CONFIG_FREERTOS_UNICORE=n
CONFIG_FREERTOS_TICK_RATE_HZ=1000

# UART console
CONFIG_ESP_CONSOLE_UART=y
CONFIG_ESP_CONSOLE_UART_NUM=0
CONFIG_ESP_CONSOLE_UART_TX_GPIO=1
CONFIG_ESP_CONSOLE_UART_RX_GPIO=3
CONFIG_ESP_CONSOLE_UART_BAUDRATE=115200

# Logging
CONFIG_LOG_DEFAULT_LEVEL=3

# NVS Flash
CONFIG_NVS_ENCRYPTION=n

# LWIP settings
CONFIG_LWIP_TIMERS_ONDEMAND=y

# Power Management
CONFIG_PM_ENABLE=y
```
